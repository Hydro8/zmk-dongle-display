## dts/bindings/behaviors/app,layer-config.yaml
```yaml
description: Configuration for Application Layers

compatible: "app,layer-config"

include: base.yaml

properties:
  auto-layers:
    type: array
    required: false
    description: List of layer indices that should activate automatically.
```

## dts/bindings/behaviors/zmk,behavior-app-layer.yaml
```yaml
description: Application Layer behavior

compatible: "zmk,behavior-app-layer"

include: zero_param.yaml

properties:
  "#binding-cells":
    const: 0
```
